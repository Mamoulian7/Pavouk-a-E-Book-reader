#include <Arduino.h>
#include <WiFi.h>
#include <HTTPClient.h>
#include <ArduinoJson.h>
#include <SPI.h>
#include <Adafruit_GFX.h>
#include <GxEPD2_3C.h>
#include <U8g2_for_Adafruit_GFX.h>
#include <driver/i2s.h>
#include <WiFiClientSecure.h>
#include <mbedtls/base64.h> // Knihovna pro převod zvuku pro Google API

// --- NASTAVENÍ WI-FI A API ---
const char* ssid = "XXX";
const char* password = "XXX";
#define GOOGLE_API_KEY "XXX" // <--- ZDE VLOŽTE GOOGLE KLÍČ

// --- PINY DISPLEJE (ESP32-S3) ---
#define EPD_PWR  8
#define EPD_BUSY 9
#define EPD_RST  10
#define EPD_DC   11
#define EPD_CS   12
#define EPD_MOSI 13
#define EPD_SCK  14
#define EPD_MISO -1 

// --- PINY JOYSTICKU (ESP32-S3) ---
#define BTN_HOME    4  
#define BTN_RANDOM  5  
#define BTN_SEARCH  6  
#define BTN_UP      7  
#define BTN_DWN     15  
#define BTN_LEFT    16  
#define BTN_RIGHT   17  

// --- PINY ZVUKU A MIKROFONU (ESP32-S3) ---
#define BUZZER_PIN  18 
#define I2S_BCLK    42
#define I2S_LRCLK   41
#define I2S_DOUT    40

GxEPD2_3C<GxEPD2_420c_GDEY042Z98, GxEPD2_420c_GDEY042Z98::HEIGHT> display(GxEPD2_420c_GDEY042Z98(EPD_CS, EPD_DC, EPD_RST, EPD_BUSY));
U8G2_FOR_ADAFRUIT_GFX u8g2Fonts;

const String randomUrl = "https://cs.wikipedia.org/w/api.php?action=query&generator=random&grnnamespace=0&prop=extracts&exintro&explaintext&format=json&origin=*";

String currentTitle = "";
String currentText = "";
int currentPage = 0;
const int CHARS_PER_PAGE = 450; 
bool isReadingArticle = false;

// 's-l1600', 200x200px
const unsigned char logo_dont_panic [] PROGMEM = {
	0x00, 0x00, 0x00, 0x00, 0x00, 0x00, 0x00, 0x00, 0x00, 0x00, 0x00, 0x00, 0x00, 0x00, 0x00, 0x00, 
	0x00, 0x00, 0x00, 0x00, 0x00, 0x00, 0x00, 0x00, 0x00, 0x00, 0x00, 0x00, 0x00, 0x00, 0x00, 0x00, 
	0x00, 0x00, 0x00, 0x00, 0x00, 0x00, 0x00, 0x00, 0x00, 0x00, 0x00, 0x00, 0x00, 0x00, 0x00, 0x00, 
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	0x00, 0x00, 0x00, 0x00, 0x00, 0x00, 0x00, 0x00
};

// Array of all bitmaps for convenience. (Total bytes used to store images in PROGMEM = 5024)
const int logo_dont_panicallArray_LEN = 1;
const unsigned char* logo_dont_panicallArray[1] = {
	logo_dont_panic
};

// --- ZVUKOVÉ FUNKCE ---
void playBeep(int freq, int duration) {
  tone(BUZZER_PIN, freq, duration);
  delay(duration + 20); 
}

void soundStartup() {
  playBeep(523, 100); 
  playBeep(659, 100); 
  playBeep(784, 100); 
  playBeep(1046, 200); 
}

void soundClick() {
  tone(BUZZER_PIN, 1200, 30); 
}

void soundRandom() {
  for(int i = 400; i < 1500; i += 100) {
    tone(BUZZER_PIN, i, 20);
    delay(20);
  }
  noTone(BUZZER_PIN);
}

void soundError() {
  playBeep(300, 250);
  playBeep(200, 400); 
}

void soundRecordStart() { playBeep(1000, 100); playBeep(1500, 100); }
void soundRecordStop() { playBeep(1500, 100); playBeep(1000, 100); }

String urlEncode(String str) {
  String encodedString = "";
  for (int i = 0; i < str.length(); i++) {
    char c = str.charAt(i);
    if (c == ' ') { encodedString += '+'; } 
    else if (isalnum(c)) { encodedString += c; } 
    else {
      char code1 = (c & 0xf) + '0'; if ((c & 0xf) > 9) code1 = (c & 0xf) - 10 + 'A';
      c = (c >> 4) & 0xf;
      char code0 = c + '0'; if (c > 9) code0 = c - 10 + 'A';
      encodedString += '%'; encodedString += code0; encodedString += code1;
    }
    yield();
  }
  return encodedString;
}

void initI2S() {
  i2s_config_t i2s_config = {
    .mode = (i2s_mode_t)(I2S_MODE_MASTER | I2S_MODE_RX),
    .sample_rate = 16000,
    .bits_per_sample = I2S_BITS_PER_SAMPLE_32BIT,
    .channel_format = I2S_CHANNEL_FMT_ONLY_LEFT,
    .communication_format = I2S_COMM_FORMAT_STAND_I2S,
    .intr_alloc_flags = ESP_INTR_FLAG_LEVEL1,
    .dma_buf_count = 8,
    .dma_buf_len = 1024,
    .use_apll = false,
    .tx_desc_auto_clear = false,
    .fixed_mclk = 0
  };
  i2s_pin_config_t pin_config = {
    .bck_io_num = I2S_BCLK,
    .ws_io_num = I2S_LRCLK,
    .data_out_num = I2S_PIN_NO_CHANGE,
    .data_in_num = I2S_DOUT
  };
  i2s_driver_install(I2S_NUM_0, &i2s_config, 0, NULL);
  i2s_set_pin(I2S_NUM_0, &pin_config);
}

// Deklarace funkcí
void drawHomeScreen();
void fetchAndDrawRandomArticle();
void recordAndSearch();
void drawCurrentArticlePage();
void drawErrorScreen(String title, String message);
void fetchAndDrawSearchArticle(String query);
void connectWiFi();
void checkWiFiConnection();

void setup() {
  Serial.begin(115200);
  delay(500);

  pinMode(BUZZER_PIN, OUTPUT);
  soundStartup(); 

  pinMode(BTN_HOME, INPUT_PULLDOWN);
  pinMode(BTN_RANDOM, INPUT_PULLDOWN);
  pinMode(BTN_SEARCH, INPUT_PULLDOWN);
  pinMode(BTN_UP, INPUT_PULLDOWN);
  pinMode(BTN_DWN, INPUT_PULLDOWN);
  pinMode(BTN_LEFT, INPUT_PULLDOWN);
  pinMode(BTN_RIGHT, INPUT_PULLDOWN);

  pinMode(EPD_PWR, OUTPUT);
  digitalWrite(EPD_PWR, HIGH);
  delay(100); 

  SPI.begin(EPD_SCK, EPD_MISO, EPD_MOSI, EPD_CS); 
  display.init(115200, true, 50, false); 
  display.setRotation(1); 

  u8g2Fonts.begin(display);
  u8g2Fonts.setFontMode(1);                 
  u8g2Fonts.setFontDirection(0);            
  
  connectWiFi();
  initI2S(); 
  drawHomeScreen();
}

void loop() {
  if (digitalRead(BTN_HOME) == HIGH || digitalRead(BTN_LEFT) == HIGH) {
    soundClick();
    drawHomeScreen();
    delay(1000); 
  }
  
  if (digitalRead(BTN_RANDOM) == HIGH || digitalRead(BTN_RIGHT) == HIGH) {
    soundRandom();
    fetchAndDrawRandomArticle();
    delay(1000);
  }
  
  if (digitalRead(BTN_SEARCH) == HIGH) {
    recordAndSearch(); 
    delay(1000);
  }

  if (digitalRead(BTN_DWN) == HIGH && isReadingArticle) {
    int maxPages = (currentText.length() / CHARS_PER_PAGE);
    if (currentPage < maxPages) {
      soundClick();
      currentPage++;
      drawCurrentArticlePage();
    } else {
      soundError(); 
    }
    delay(1000);
  }

  if (digitalRead(BTN_UP) == HIGH && isReadingArticle) {
    if (currentPage > 0) {
      soundClick();
      currentPage--;
      drawCurrentArticlePage();
    } else {
      soundError(); 
    }
    delay(1000);
  }
  
  delay(50);
}

void connectWiFi() {
  Serial.print("Pripojovani k siti...");
  WiFi.begin(ssid, password);
  while (WiFi.status() != WL_CONNECTED) {
    delay(500);
    Serial.print(".");
  }
  Serial.println("\nPripojeno!");
}

void checkWiFiConnection() {
  if (WiFi.status() != WL_CONNECTED) {
    Serial.println("Obnovuji Wi-Fi spojeni...");
    connectWiFi();
  }
}

String cleanPunctuation(String text) {
  text.trim();
  while(text.length() > 0 && (text.endsWith(".") || text.endsWith(",") || text.endsWith("!") || text.endsWith("?"))) {
    text = text.substring(0, text.length() - 1);
  }
  return text;
}

void fetchAndDrawSearchArticle(String query) {
  checkWiFiConnection();
  
  String searchUrl = "https://cs.wikipedia.org/w/api.php?action=query&generator=search&gsrsearch=" + urlEncode(query) + "&gsrlimit=1&prop=extracts&exintro&explaintext&format=json&origin=*";
  
  HTTPClient http;
  http.begin(searchUrl);
  int httpCode = http.GET();
  
  if (httpCode != HTTP_CODE_OK) {
    soundError();
    drawErrorScreen("Chyba spojeni", "Galakticka databaze neodpovida.");
    isReadingArticle = false;
    return;
  }

  String payload = http.getString();
  http.end();

  JsonDocument doc;
  DeserializationError error = deserializeJson(doc, payload);

  if (error) {
    soundError();
    drawErrorScreen("Chyba dat", "Data byla znicena v hyperprostoru.");
    isReadingArticle = false;
    return;
  }

  JsonObject pages = doc["query"]["pages"];
  currentTitle = "";
  currentText = "";

  for (JsonPair kv : pages) {
    currentTitle = kv.value()["title"].as<String>();
    currentText = kv.value()["extract"].as<String>();
    break; 
  }

  if (currentTitle == "") {
     soundError();
     drawErrorScreen("Nenalezeno", "Ve vesmiru o tomto nevime absolutne nic.");
     isReadingArticle = false;
     return;
  }

  if (currentText.length() == 0) {
     currentText = "Heslo sice existuje, ale neobsahuje zadny text.";
  }

  currentPage = 0;
  isReadingArticle = true;
  drawCurrentArticlePage();
}

void recordAndSearch() {
  display.firstPage();
  do {
    display.fillScreen(GxEPD_WHITE);
    u8g2Fonts.setForegroundColor(GxEPD_BLACK);
    u8g2Fonts.setFont(u8g2_font_helvB18_te);
    u8g2Fonts.setCursor(30, 200);
    u8g2Fonts.print("Mluvte ted...");
  } while (display.nextPage());

  soundRecordStart();

  int maxSamples = 16000 * 5; 
  int16_t* audioBuffer = (int16_t*)ps_malloc(maxSamples * 2);
  if (!audioBuffer) audioBuffer = (int16_t*)malloc(maxSamples * 2);
  
  if (!audioBuffer) {
    soundError();
    drawErrorScreen("Chyba pameti", "Zkontrolujte nastaveni OPI PSRAM.");
    return;
  }

  int sampleCount = 0;
  size_t bytesRead;
  int32_t rawSample = 0;
  
  i2s_read(I2S_NUM_0, &rawSample, 4, &bytesRead, 100); // Vyčištění bufferu

  while (digitalRead(BTN_SEARCH) == HIGH && sampleCount < maxSamples) {
    i2s_read(I2S_NUM_0, &rawSample, 4, &bytesRead, portMAX_DELAY);
    rawSample >>= 14; 
    audioBuffer[sampleCount++] = (int16_t)rawSample;
  }

  soundRecordStop();

  display.firstPage();
  do {
    display.fillScreen(GxEPD_WHITE);
    u8g2Fonts.setCursor(30, 200);
    u8g2Fonts.print("Prekladam (Google)...");
  } while (display.nextPage());

  checkWiFiConnection();

  Serial.printf("\n--- DIAGNOSTIKA PAMETI ---\n");
  Serial.printf("Volna interni RAM: %d\n", ESP.getFreeHeap());
  Serial.printf("Volna PSRAM: %d\n", ESP.getFreePsram());
  
  // --- GOOGLE CLOUD SPEECH-TO-TEXT ---
  Serial.println("Pripravuji data pro Google API...");
  
  size_t audioSize = sampleCount * 2;
  size_t b64Size = 0;
  mbedtls_base64_encode(NULL, 0, &b64Size, (const unsigned char*)audioBuffer, audioSize);
  
  char* b64Buffer = (char*)ps_malloc(b64Size + 1);
  if (!b64Buffer) {
    free(audioBuffer);
    Serial.println("CHYBA: Nedostatek PSRAM pro Base64 buffer!");
    drawErrorScreen("Chyba pameti", "Nelze alokovat pamet pro Base64.");
    return;
  }
  
  size_t written = 0;
  mbedtls_base64_encode((unsigned char*)b64Buffer, b64Size + 1, &written, (const unsigned char*)audioBuffer, audioSize);
  free(audioBuffer); 
  
  String jsonPayload = "{\"config\":{\"encoding\":\"LINEAR16\",\"sampleRateHertz\":16000,\"languageCode\":\"cs-CZ\"},\"audio\":{\"content\":\"";
  jsonPayload += String(b64Buffer);
  jsonPayload += "\"}}";
  
  free(b64Buffer); // Uvolníme Base64 text co nejdříve
  
  Serial.println("Odesilam na Google Cloud pres HTTPClient...");
  
  WiFiClientSecure client;
  client.setInsecure(); // Přeskočení kontroly certifikátu
  
  HTTPClient http;
  http.setTimeout(25000); 
  
  String url = "https://speech.googleapis.com/v1/speech:recognize?key=" + String(GOOGLE_API_KEY);
  
  if (http.begin(client, url)) {
    http.addHeader("Content-Type", "application/json");
    
    int httpResponseCode = http.POST(jsonPayload);
    
    if (httpResponseCode > 0) {
      String responseBody = http.getString();
      Serial.println("--- ODPOVED Z GOOGLE API ---");
      Serial.println(responseBody);
      
      JsonDocument doc;
      DeserializationError error = deserializeJson(doc, responseBody);
      
      String query = "";
      if (!error && doc.containsKey("results")) {
        query = doc["results"][0]["alternatives"][0]["transcript"].as<String>();
        query = cleanPunctuation(query);
      }
      
      if (query == "") {
        soundError();
        Serial.println("Chyba: Google API nevratilo zadny text (nebo nebylo nic rozpozano).");
        drawErrorScreen("Nerozumim", "Zkuste mluvit bliz k mikrofonu.");
        http.end();
        return;
      }

      Serial.println("Hledam heslo: " + query);
      display.firstPage();
      do {
        display.fillScreen(GxEPD_WHITE);
        u8g2Fonts.setCursor(30, 200);
        u8g2Fonts.print("Hledam: " + query);
      } while (display.nextPage());

      fetchAndDrawSearchArticle(query);
    } else {
      Serial.printf("Chyba POST pozadavku: %d - %s\n", httpResponseCode, http.errorToString(httpResponseCode).c_str());
      drawErrorScreen("Chyba spojeni", "Chyba HTTP: " + http.errorToString(httpResponseCode));
    }
    http.end();
  } else {
    Serial.println("Nelze navazat SSL spojeni s Google API.");
    drawErrorScreen("Chyba site", "SSL spojeni selhalo.");
  }
}

void fetchAndDrawRandomArticle() {
  checkWiFiConnection();
  
  HTTPClient http;
  http.begin(randomUrl);
  int httpCode = http.GET();
  
  if (httpCode != HTTP_CODE_OK) {
    soundError();
    drawErrorScreen("Chyba spojení", "Spojení s Galaktickou databází selhalo.");
    isReadingArticle = false;
    return;
  }

  String payload = http.getString();
  http.end();

  JsonDocument doc;
  DeserializationError error = deserializeJson(doc, payload);

  if (error) {
    soundError();
    drawErrorScreen("Chyba dat", "Data byla zničena v hyperprostoru.");
    isReadingArticle = false;
    return;
  }

  JsonObject pages = doc["query"]["pages"];
  currentTitle = "";
  currentText = "";

  for (JsonPair kv : pages) {
    currentTitle = kv.value()["title"].as<String>();
    currentText = kv.value()["extract"].as<String>();
    break; 
  }

  if (currentText.length() == 0) {
     currentText = "Heslo sice existuje, ale neobsahuje žádný text. Zřejmě ho snědla blýskavice.";
  }

  currentPage = 0;
  isReadingArticle = true;
  drawCurrentArticlePage();
}

void printWrappedText(String text, int startX, int startY, int maxWidth) {
  int x = startX;
  int y = startY;
  int lineHeight = u8g2Fonts.getFontAscent() - u8g2Fonts.getFontDescent() + 4; 
  
  String word = "";
  for (int i = 0; i <= text.length(); i++) {
    char c = (i < text.length()) ? text.charAt(i) : ' ';
    if (c == ' ' || c == '\n' || i == text.length()) {
      if (word.length() > 0) {
        int wordWidth = u8g2Fonts.getUTF8Width(word.c_str());
        if (x + wordWidth > startX + maxWidth) {
          x = startX;
          y += lineHeight;
        }
        u8g2Fonts.setCursor(x, y);
        u8g2Fonts.print(word);
        x += wordWidth + u8g2Fonts.getUTF8Width(" ");
        word = "";
      }
      if (c == '\n') {
        x = startX;
        y += lineHeight;
      }
    } else {
      word += c;
    }
  }
}

void drawCurrentArticlePage() {
  display.setFullWindow();
  display.firstPage();
  do {
    display.fillScreen(GxEPD_WHITE);
    
    display.fillRect(0, 0, 300, 25, GxEPD_BLACK);
    u8g2Fonts.setForegroundColor(GxEPD_WHITE);
    u8g2Fonts.setBackgroundColor(GxEPD_BLACK);
    u8g2Fonts.setFont(u8g2_font_helvB12_te); 
    
    u8g2Fonts.setCursor(10, 18);
    u8g2Fonts.print("Mk.III");
    
    int maxPages = (currentText.length() / CHARS_PER_PAGE) + 1;
    u8g2Fonts.setCursor(220, 18);
    u8g2Fonts.print("STR " + String(currentPage + 1) + "/" + String(maxPages));

    u8g2Fonts.setForegroundColor(GxEPD_RED);
    u8g2Fonts.setBackgroundColor(GxEPD_WHITE);
    u8g2Fonts.setFont(u8g2_font_helvB14_te); 
    
    printWrappedText(currentTitle, 10, 50, 280);

    display.fillRect(10, 75, 280, 3, GxEPD_RED);

    u8g2Fonts.setForegroundColor(GxEPD_BLACK);
    u8g2Fonts.setFont(u8g2_font_helvB10_te); 
    
    int startIndex = currentPage * CHARS_PER_PAGE;
    int endIndex = startIndex + CHARS_PER_PAGE;
    if (endIndex > currentText.length()) endIndex = currentText.length();
    
    String pageText = currentText.substring(startIndex, endIndex);
    if (endIndex < currentText.length()) pageText += "..."; 
    
    printWrappedText(pageText, 10, 105, 280);
    
  } while (display.nextPage());
}

void drawErrorScreen(String title, String message) {
  display.setFullWindow();
  display.firstPage();
  do {
    display.fillScreen(GxEPD_WHITE);
    display.fillRect(0, 0, 300, 25, GxEPD_BLACK);
    
    u8g2Fonts.setForegroundColor(GxEPD_WHITE);
    u8g2Fonts.setBackgroundColor(GxEPD_BLACK);
    u8g2Fonts.setFont(u8g2_font_helvB12_te);
    u8g2Fonts.setCursor(10, 18);
    u8g2Fonts.print("CHYBA SYSTÉMU");

    u8g2Fonts.setForegroundColor(GxEPD_RED);
    u8g2Fonts.setBackgroundColor(GxEPD_WHITE);
    u8g2Fonts.setFont(u8g2_font_helvB18_te);
    u8g2Fonts.setCursor(10, 90);
    u8g2Fonts.print(title);

    u8g2Fonts.setForegroundColor(GxEPD_BLACK);
    u8g2Fonts.setFont(u8g2_font_helvB12_te);
    printWrappedText(message, 10, 140, 280);

  } while (display.nextPage());
}

void drawHomeScreen() {
  isReadingArticle = false;
  display.setFullWindow();
  display.firstPage();
  do {
    display.fillScreen(GxEPD_WHITE);
    
    display.fillRect(0, 0, 300, 25, GxEPD_BLACK);
    u8g2Fonts.setForegroundColor(GxEPD_WHITE);
    u8g2Fonts.setBackgroundColor(GxEPD_BLACK);
    u8g2Fonts.setFont(u8g2_font_helvB12_te);
    
    u8g2Fonts.setCursor(10, 18);
    u8g2Fonts.print("Mk.III");
    u8g2Fonts.setCursor(200, 18);
    u8g2Fonts.print("WIFI 42%");

    // VYKRESLENÍ LOGA
    display.drawBitmap(50, 35, logo_dont_panic, 200, 200, GxEPD_BLACK);
    
    display.fillRect(30, 250, 240, 4, GxEPD_RED); 
    
    u8g2Fonts.setForegroundColor(GxEPD_BLACK);
    u8g2Fonts.setBackgroundColor(GxEPD_WHITE);
    u8g2Fonts.setFont(u8g2_font_helvB12_te);
    
    u8g2Fonts.setCursor(35, 290);
    u8g2Fonts.print("SET / DOPRAVA: Náhoda");
    
    u8g2Fonts.setCursor(35, 330);
    u8g2Fonts.print("MID: Hledat (Mikrofon)");
    
    u8g2Fonts.setCursor(35, 370);
    u8g2Fonts.print("NAHORU / DOLŮ: Čtení textu");

  } while (display.nextPage());
}
